## config/west.yml
```yaml
manifest:
  remotes:
    - name: zmkfirmware
      url-base: https://github.com/zmkfirmware
  projects:
    - name: zmk
      remote: zmkfirmware
      revision: v0.3.0        # pinned stable release (avoids main breakage). Bump deliberately.
      import: app/west.yml
  self:
    path: config
```
